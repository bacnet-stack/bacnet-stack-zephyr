## CMakeLists.txt
```
# @brief CMake for BACnet basic sample
# @author Steve Karg <skarg@users.sourceforge.net>
# @date November 2025
# @copyright SPDX-License-Identifier: Apache-2.0

cmake_minimum_required(VERSION 3.13.1)

get_filename_component(MY_PROJECT_NAME ${CMAKE_CURRENT_SOURCE_DIR} NAME)

# The native_sim Ethernet driver Kconfig symbol was renamed in newer Zephyr,
# so select the matching fragment based on what the Zephyr tree provides.
if(BOARD MATCHES "^native_sim" AND DEFINED ENV{ZEPHYR_BASE})
  if(EXISTS $ENV{ZEPHYR_BASE}/drivers/ethernet/Kconfig.native_tap)
    list(APPEND EXTRA_CONF_FILE ${CMAKE_CURRENT_SOURCE_DIR}/boards/native_sim_eth_tap.conf)
  else()
    list(APPEND EXTRA_CONF_FILE ${CMAKE_CURRENT_SOURCE_DIR}/boards/native_sim_eth_posix.conf)
  endif()
endif()

find_package(Zephyr REQUIRED HINTS $ENV{ZEPHYR_BASE})
project(${MY_PROJECT_NAME})

target_sources(app PRIVATE src/main.c)
```

## Kconfig
```
# @brief Kconfig for BACnet basic sample
# @author Steve Karg <skarg@users.sourceforge.net>
# @date October 2026
# @copyright SPDX-License-Identifier: Apache-2.0

mainmenu "BACnet B-ASC sample"

# The native_sim Ethernet driver Kconfig symbol was renamed between Zephyr
# versions (ETH_NATIVE_POSIX to ETH_NATIVE_TAP). Selecting a symbol that the
# Zephyr tree does not define is ignored, so this enables whichever one exists
# in the Zephyr tree that Kconfig is actually processing.
config APP_NATIVE_SIM_ETH
    bool
    default y if BOARD_NATIVE_SIM
    select ETH_NATIVE_TAP
    select ETH_NATIVE_POSIX

source "Kconfig.zephyr"
```

## sample.yaml
```
sample:
  name: BACnet Application Specific Controller (B-ASC)

common:
  platform_allow:
    - nucleo_f429zi
  build_only: true

tests:

  bacnet-stack.sample.profile.b-asc.bacdl_none:
    tags: bacnet

  bacnet-stack.sample.profile.b-asc.bacdl_mstp:
    extra_configs:
      - CONFIG_BACDL_MSTP=y
    tags: introduction

  bacnet-stack.sample.profile.b-asc.bacdl_bip:
    extra_configs:
      - CONFIG_BACDL_BIP=y
    tags: introduction

  bacnet-stack.sample.profile.b-asc.bacdl_bip6:
    skip: true
    extra_configs:
      - CONFIG_BACDL_BIP6=y
    tags: introduction

  bacnet-stack.sample.profile.b-asc.bacdl_ethernet:
    skip: true
    extra_configs:
      - CONFIG_BACDL_ETHERNET=y
    tags: introduction
```

## prj.conf
```kconfig
# General config
#CONFIG_ASSERT=y
#CONFIG_ASSERT_LEVEL=2
#CONFIG_ASSERT_VERBOSE=y

# Compiler library config
#CONFIG_PICOLIBC=y
#CONFIG_PICOLIBC_USE_MODULE=y
#CONFIG_REQUIRES_FULL_LIBC=y
#CONFIG_MINIMAL_LIBC=y

# system
CONFIG_KERNEL_MEM_POOL=y
CONFIG_MAIN_THREAD_PRIORITY=7
#CONFIG_PICOLIBC=y
CONFIG_ISR_STACK_SIZE=8192
CONFIG_IDLE_STACK_SIZE=2048
CONFIG_INIT_STACKS=y
CONFIG_NET_TX_STACK_SIZE=8192
CONFIG_NET_RX_STACK_SIZE=8192
CONFIG_HEAP_MEM_POOL_SIZE=16384
CONFIG_MAIN_STACK_SIZE=16384
CONFIG_BACNET_BASIC_SERVER_KSLEEP=100

# BACnet Library
CONFIG_BACNETSTACK=y
# BACnet Library - shell
CONFIG_BACNETSTACK_BACNET_SHELL=y
CONFIG_BACNETSTACK_BACNET_BASIC_SHELL=y
CONFIG_BACNETSTACK_BACNET_FILE_SHELL=y
CONFIG_BACAPP_PRINT_ENABLED=y
CONFIG_SHELL_STACK_SIZE=16384
# BACnet settings subsystem
CONFIG_BACNETSTACK_BACNET_SETTINGS=y
CONFIG_BACNET_SETTINGS_SHELL=y
# BACnet Library - options
CONFIG_BACNET_MAX_CHARACTER_STRING_BYTES=128
# BACnet Library - enable required basic objects
CONFIG_BACNET_BASIC_OBJECT_NETWORK_PORT=y
# BACnet Library - enable basic objects
CONFIG_BACNET_BASIC_OBJECTS_ACCESS=y
CONFIG_BACNET_BASIC_OBJECT_ACCUMULATOR=y
CONFIG_BACNET_BASIC_OBJECT_ANALOG_INPUT=y
CONFIG_BACNET_BASIC_OBJECT_ANALOG_OUTPUT=y
CONFIG_BACNET_BASIC_OBJECT_ANALOG_VALUE=y
CONFIG_BACNET_BASIC_OBJECT_AVERAGING=y
CONFIG_BACNET_BASIC_OBJECT_AUDIT_LOG=y
CONFIG_BACNET_BASIC_OBJECT_FILE=y
CONFIG_BACNET_BASIC_OBJECT_BINARY_INPUT=y
CONFIG_BACNET_BASIC_OBJECT_BINARY_OUTPUT=y
CONFIG_BACNET_BASIC_OBJECT_BINARY_VALUE=y
CONFIG_BACNET_BASIC_OBJECT_CALENDAR=y
CONFIG_BACNET_BASIC_OBJECT_CHANNEL=y
CONFIG_BACNET_BASIC_OBJECT_COMMAND=y
CONFIG_BACNET_BASIC_OBJECT_COLOR=y
CONFIG_BACNET_BASIC_OBJECT_COLOR_TEMPERATURE=y
CONFIG_BACNET_BASIC_OBJECT_CHARACTERSTRING_VALUE=y
CONFIG_BACNET_BASIC_OBJECT_INTEGER_VALUE=y
CONFIG_BACNET_BASIC_OBJECT_LOAD_CONTROL=y
CONFIG_BACNET_BASIC_OBJECT_LOOP=y
CONFIG_BACNET_BASIC_OBJECT_LIGHTING_OUTPUT=y
CONFIG_BACNET_BASIC_OBJECT_BINARY_LIGHTING_OUTPUT=y
CONFIG_BACNET_BASIC_OBJECT_LIFE_SAFETY_POINT=y
CONFIG_BACNET_BASIC_OBJECT_MULTISTATE_INPUT=y
CONFIG_BACNET_BASIC_OBJECT_MULTISTATE_OUTPUT=y
CONFIG_BACNET_BASIC_OBJECT_MULTISTATE_VALUE=y
CONFIG_BACNET_BASIC_OBJECT_NOTIFICATION_CLASS=y
CONFIG_BACNET_BASIC_OBJECT_OCTET_STRING_VALUE=y
CONFIG_BACNET_BASIC_OBJECT_POSITIVE_INTEGER_VALUE=y
CONFIG_BACNET_BASIC_OBJECT_SCHEDULE=y
CONFIG_BACNET_BASIC_OBJECT_STRUCTURED_VIEW=y
CONFIG_BACNET_BASIC_OBJECT_TIME_VALUE=y
CONFIG_BACNET_BASIC_OBJECT_TIMER=y
CONFIG_BACNET_BASIC_OBJECT_TRENDLOG=y
# Access Control Objects
CONFIG_BACNET_BASIC_OBJECTS_ACCESS=y
# Backup and Restore
CONFIG_BACNET_BASIC_BACKUP_RESTORE=y
# Increase the default size of the octet strings to allow for file transfers
# note: the maximum size of a BACnet APDU is 1476 bytes, so this leaves room
# for the header and some data
CONFIG_BACNET_MAX_OCTET_STRING_BYTES=1450
# Property value container data types supported
CONFIG_BACAPP_ALL=y
CONFIG_BACNET_TIMER_VALUE_ALL=y
CONFIG_CHANNEL_VALUE_ALL=y

# BACnet Library - server framework - includes device and ports
CONFIG_BACNET_BASIC_SERVER=y

# BACnet Datalink Options
CONFIG_BACDL_BIP=y
CONFIG_BACDL_BIP_PORT=47808
# don't define index if you want to use the default interface
# note: with DHCP and AutoIP enabled, index 0=AutoIP, 1=DHCP
# CONFIG_BACDL_BIP_ADDRESS_INDEX=1

# networking
CONFIG_NETWORKING=y
CONFIG_NET_L2_ETHERNET=y
CONFIG_NET_ARP=y
CONFIG_NET_UDP=y
CONFIG_NET_SHELL=y
CONFIG_NET_SOCKETS=y
CONFIG_NET_IPV4=y
CONFIG_NET_IPV4_LOG_LEVEL_DBG=n
CONFIG_NET_IF_MAX_IPV4_COUNT=2
CONFIG_NET_IF_UNICAST_IPV4_ADDR_COUNT=2
CONFIG_NET_IF_MCAST_IPV4_ADDR_COUNT=2
# Dynamic IP address
CONFIG_NET_DHCPV4=y
CONFIG_NET_DHCPV4_LOG_LEVEL_DBG=n
CONFIG_NET_IPV4_AUTO=n
CONFIG_NET_IPV4_AUTO_LOG_LEVEL_DBG=n
CONFIG_NET_ICMPV4_LOG_LEVEL_DBG=n
# read the MAC address from settings and set via net_mgmt()
CONFIG_NET_MGMT_EVENT=y
CONFIG_NET_L2_ETHERNET_MGMT=y
CONFIG_NET_CONNECTION_MANAGER=y

# Static IP address pre-configuration
#CONFIG_NET_CONFIG_SETTINGS=y
#CONFIG_NET_CONFIG_MY_IPV4_ADDR="192.0.2.1"
#CONFIG_NET_CONFIG_MY_IPV4_NETMASK="255.255.255.0"
#CONFIG_NET_CONFIG_MY_IPV4_GW="192.0.2.2"
# Network debug config
CONFIG_NET_LOG=y
CONFIG_NET_SHELL=y

#CONFIG_DNS_RESOLVER=y
#CONFIG_SLIP_STATISTICS=n

# Enable Shell, Console, and Logging features
CONFIG_CONSOLE=y
CONFIG_PRINTK=y
CONFIG_SHELL=y
CONFIG_KERNEL_SHELL=y
CONFIG_THREAD_MONITOR=y
#CONFIG_BOOT_BANNER=n
CONFIG_THREAD_NAME=y
CONFIG_DEVICE_SHELL=y
#CONFIG_POSIX_CLOCK=y
#CONFIG_DATE_SHELL=y
CONFIG_LOG=y
CONFIG_LOG_BACKEND_UART=y
CONFIG_SHELL_LOG_BACKEND=n
#CONFIG_LOG_STRDUP_BUF_COUNT=4
#CONFIG_LOG_STRDUP_MAX_STRING=96
#CONFIG_NET_CONN_LOG_LEVEL_DEFAULT=n
#CONFIG_NET_CONN_LOG_LEVEL_DBG=y
#CONFIG_NET_IF_LOG_LEVEL_DEFAULT=n
CONFIG_NET_IF_LOG_LEVEL_DBG=n
CONFIG_NET_LOG=y

# enable the thread, stack, and runtime stats
CONFIG_THREAD_ANALYZER=y
CONFIG_THREAD_STACK_INFO=y
CONFIG_THREAD_RUNTIME_STATS=y
#CONFIG_THREAD_RUNTIME_STATS_USE_TIMING_FUNCTIONS=n
#CONFIG_SCHED_THREAD_USAGE=y
#CONFIG_SCHED_THREAD_USAGE_ANALYSIS=y
CONFIG_STATS=y
CONFIG_STATS_SHELL=y

#
# Storage
#
CONFIG_FLASH=y
CONFIG_FLASH_MAP=y
#CONFIG_FLASH_PAGE_LAYOUT=y
CONFIG_NVS=y
CONFIG_SETTINGS=y
CONFIG_SETTINGS_NVS=y
CONFIG_SETTINGS_RUNTIME=y
CONFIG_REBOOT=y
#CONFIG_SETTINGS_FILE=y
#CONFIG_SETTINGS_SHELL=y
# native_posix uses a simulated flash
#CONFIG_FLASH_SIMULATOR=y
#CONFIG_DISK_ACCESS=y.
#CONFIG_FILE_SYSTEM=y
#CONFIG_FILE_SYSTEM_LITTLEFS=y
#CONFIG_FILE_SYSTEM_SHELL=y

CONFIG_TEST_RANDOM_GENERATOR=y
CONFIG_TIMER_RANDOM_GENERATOR=y
```

## boards/native_sim.conf
```kconfig
# needed for shell on native sim
CONFIG_NET_TCP=y
CONFIG_SHELL_BACKEND_TELNET=y
CONFIG_SHELL_TELNET_PORT=23
```

## boards/native_sim_eth_posix.conf
```kconfig
# Older Zephyr (e.g. 3.7): native_sim uses the native_posix Ethernet driver
CONFIG_ETH_NATIVE_POSIX=y
```

## boards/native_sim_eth_tap.conf
```kconfig
# Newer Zephyr: native_sim TAP Ethernet driver
CONFIG_ETH_NATIVE_TAP=y
```

## boards/nucleo_f429zi.overlay
```dts
/*
 * Copyright (c) 2022 STMicroelectronics
 *
 * SPDX-License-Identifier: Apache-2.0
 */
/* FIXME: remove 'delete-node' if building with Zephyr version 4 or later */
/delete-node/ &storage_partition;

&flash0 {
  partitions {
    /*
     * nvs subsystem requires 2 sectors with a max total of 32K
     * On F4 series, the only option is to use the following
     * partition, which is compatible with mcuboot usage.
     * (limited by nvs.h: uint16_t sector_size)
     * Located in the first two 16K sectors of the second flash bank
     * (0x100000), above the firmware image which is linked at 0x0 when
     * not using mcuboot. A storage partition overlapping the firmware
     * would make the settings init fail (-EDEADLK) and erasing it would
     * erase the running firmware.
     */
    storage_partition: partition@100000 {
      compatible = "zephyr,mapped-partition";
      label = "storage";
      reg = <0x0100000 DT_SIZE_K(32)>;
    };
  };
};
```

## src/main.c
```c
/**
 * @file
 * @brief BACnet Stack sample Application Specific Controller (B-ASC) main file
 * @author Steve Karg <skarg@users.sourceforge.net>
 * @date November 2025
 * @copyright SPDX-License-Identifier: Apache-2.0
 */
#include <zephyr/kernel.h>
#include <zephyr/random/random.h>
#include <stdint.h>
#include <stdlib.h>

/* BACnet Stack defines - first */
#include "bacnet/bacdef.h"
/* BACnet Stack core API */
#include "bacnet/version.h"
#include "bacnet/datetime.h"
#include "bacnet/bactext.h"
#include "bacnet/basic/services.h"
#include "bacnet/basic/sys/bramfs.h"
#include "bacnet/basic/sys/mstimer.h"
#include "bacnet/basic/sys/linear.h"
/* BACnet Stack basic device API -
   see bacnet/basic/server/bacnet_device.c for details */
#include "bacnet/basic/object/device.h"
#include "bacnet/basic/object/bacfile.h"
#include "bacnet/basic/object/netport.h"
#include "bacnet/basic/server/bacnet_basic.h"
#include "bacnet/basic/server/bacnet_port.h"
/* BACnet Stack Zephyr services */
#include <bacnet_settings/bacnet_settings.h>
#include <bacnet_osif/bacnet_lock.h>
#include <bacnet_osif/bacnet_reinit.h>
/* Logging module registration is already done in ports/zephyr/main.c */
#include <bacnet_osif/bacnet_log.h>
LOG_MODULE_DECLARE(bacnet, CONFIG_BACNETSTACK_LOG_LEVEL);

/* Default values before we get the device instance and name from settings */
static const uint32_t Device_Instance = 260127;
static const char *Device_Name =
    "BACnet Application Specific Controller (B-ASC)";

/**
 * @brief Clear any stored BACnet settings before a cold start reboot
 * @param context [in] The context to pass to the callback function
 */
static void BACnet_Device_Coldstart_Callback(void *context)
{
    int err;

    (void)context;
    LOG_INF("COLDSTART: Clearing BACnet settings...");
    err = bacnet_settings_clear();
    if (err < 0) {
        LOG_ERR("COLDSTART: Failed to clear BACnet settings: %d", err);
    } else {
        LOG_INF("COLDSTART: Successfully cleared BACnet settings");
    }
}

/**
 * @brief Callback data for WriteProperty restore iterator
 * @param write_function The WriteProperty function to call
 * @param context The context to pass to the WriteProperty function
 * @return true if the WriteProperty succeeded
 */
static bool
Settings_Restore_Callback(BACNET_WRITE_PROPERTY_DATA *wp_data, void *context)
{
    (void)context;
    return Device_Write_Property(wp_data);
}

/**
 * @brief BACnet Project Initialization Handler
 * @param context [in] The context to pass to the callback function
 * @note This is called from the BACnet task
 */
static void BACnet_Device_Init_Handler(void *context)
{
    BACNET_CREATE_OBJECT_DATA object_data = { 0 };
    unsigned int i = 0;
    uint32_t instance;
    const char *empty_data = "empty";

    (void)context;
    LOG_INF("BACnet Stack Initialized");
    /* create some dynamically created objects as examples */
    object_data.object_instance = BACNET_MAX_INSTANCE;
    for (i = 0; i <= BACNET_OBJECT_TYPE_RESERVED_MIN; i++) {
        object_data.object_type = i;
        if (Device_Create_Object(&object_data)) {
            LOG_INF(
                "Created object %s-%u\n", bactext_object_type_name(i),
                (unsigned)object_data.object_instance);
        }
    }
    /* Backup and restore uses a file */
    instance = bacfile_index_to_instance(0);
    if (instance >= BACNET_MAX_INSTANCE) {
        LOG_ERR("No file object instance available for backup/restore");
    } else {
        bacfile_pathname_set(instance, "bacnet.dat");
        Device_Configuration_File_Set(0, instance);
        /* use a RAM FS backend for this sample */
        bacfile_ramfs_init();
        bacfile_ramfs_write_stream_data(
            bacfile_pathname(instance), 0, empty_data, strlen(empty_data));
        LOG_INF(
            "Backup/Restore file-%u path=%s", instance,
            bacfile_pathname(instance));
    }
    /* initialize objects with default values for this basic sample */
    Device_Set_Object_Instance_Number(Device_Instance);
    Device_Object_Name_ANSI_Init(Device_Name);
    /* restore any property values previously stored via WriteProperty */
    bacnet_settings_init();
    bacnet_settings_write_property_restore(&Settings_Restore_Callback, NULL);
    /* writable property values are stored with WriteProperty.
       Set this callback after restore to prevent recursion. */
    bacnet_basic_store_callback_set(bacnet_settings_basic_store);
    apdu_set_unconfirmed_handler(
        SERVICE_UNCONFIRMED_WRITE_GROUP, handler_write_group);
    /* initialize timesync callback function. */
    /* local time and date */
    apdu_set_unconfirmed_handler(
        SERVICE_UNCONFIRMED_TIME_SYNCHRONIZATION, handler_timesync);
    handler_timesync_set_callback_set(datetime_timesync);
    datetime_init();
    /* done */
    LOG_INF("BACnet Device ID: %u", Device_Object_Instance_Number());
    bacnet_basic_task_object_timer_set(1000UL);
    bacnet_reinitialize_device_init(CONFIG_BACNET_REINIT_REBOOT_DELAY);
    srand(sys_rand32_get());
}

/**
 * @brief BACnet Project Task Handler
 * @param context [in] The context to pass to the callback function
 * @note This is called from the BACnet task
 */
static void BACnet_Device_Task_Handler(void *context)
{
    bacnet_reinitialize_device_task(BACnet_Device_Coldstart_Callback, context);
}

int main(void)
{
    bool port_initialized = false;

    LOG_INF("BACnet Device: %s", Device_Name);
    LOG_INF("BACnet Stack Version " BACNET_VERSION_TEXT);
    LOG_INF("BACnet Stack Max APDU: %d", MAX_APDU);
    bacnet_basic_init_callback_set(BACnet_Device_Init_Handler, NULL);
    bacnet_basic_task_callback_set(BACnet_Device_Task_Handler, NULL);
    bacnet_lock();
    bacnet_basic_init();
    bacnet_unlock();
    for (;;) {
        k_sleep(K_MSEC(CONFIG_BACNET_BASIC_SERVER_KSLEEP));
        bacnet_lock();
        bacnet_basic_task();
        if (port_initialized) {
            bacnet_port_task();
        }
        bacnet_unlock();
        /* Port init can wait for an IPv4 address. Keep that wait outside
           the BACnet lock. */
        if (!port_initialized) {
            port_initialized = bacnet_port_init();
        }
    }

    return 0;
}
```
