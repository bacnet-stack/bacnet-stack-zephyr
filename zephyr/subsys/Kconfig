## zephyr/subsys/Kconfig
```kconfig
# Copyright (c) 2020 Legrand North America, LLC.
# SPDX-License-Identifier: Apache-2.0
# Kconfig - Subsystem configuration options

comment "BACnet Subsystems"

rsource "bacnet_datalink/Kconfig"
rsource "bacnet_settings/Kconfig"
rsource "bacnet_shell/Kconfig"
rsource "object/Kconfig"
rsource "server/Kconfig"
```

## zephyr/subsys/bacnet_basic/Kconfig
```kconfig
# Kconfig - Subsystem configuration options
#
# @author Steve Karg <skarg@users.sourceforge.net>
# @date May 2024
# @copyright SPDX-License-Identifier: Apache-2.0
menuconfig BACNETSTACK_BACNET_BASIC
    bool "BACNETSTACK_BACNET_BASIC"
	default n
    help
      This option enables a basic BACnet Device object and tasking

if BACNETSTACK_BACNET_BASIC

    module = BACNETSTACK_BACNET_BASIC
    module-str = bacnet_basic

	config BACNET_BASIC_DEVICE_OBJECT_NAME
		string "BACnet device object default name"
		default "Basic Server"
		help
			BACnet device object default name

	config BACNET_BASIC_DEVICE_OBJECT_VERSION
		string "BACnet device object default application version string"
		default "1.0.0"
		help
			BACnet device object default application version string

	config BACNET_BASIC_DEVICE_DESCRIPTION
		string "BACnet device object default description string"
		default "BACnet Basic Server"
		help
			BACnet device object default description string

	config BACNET_BASIC_DEVICE_MODEL_NAME
		string "BACnet device object default model name string"
		default "Basic Server"
		help
			BACnet device object default model name string

	config BACNET_BASIC_DEVICE_SHELL
		bool "BACnet Basic Device subsystem shell"
		depends on BACNETSTACK
		default y if SHELL

	config BACNET_BASIC_SERVER_KSLEEP
		int "Minimum ksleep time for BACnet Basic Server task"
		default 10
		help
			BACnet Stack KSLEEP time in milliseconds

	config BACNET_BASIC_SERVER_INIT_PRIORITY
		int "Initialization priority"
		default APPLICATION_INIT_PRIORITY
		range 0 99
		help
		  Initialization priority in the main thread for BACnet Basic Server where 0 is the highest priority.

    config BACNET_BASIC_SERVER_THREAD_PRIORITY
        int "Thread priority"
		default 10
		range 0 NUM_PREEMPT_PRIORITIES
        help
          This sets the thread priority of the BACnet Basic Server where 0 is the highest priority.

    config BACNET_BASIC_SERVER_STACK_SIZE
        int "BACnet server stack size"
        default 8192
        help
          This sets the stack size of the thread.



endif # BACNETSTACK_BACNET_SETTINGS
```

## zephyr/subsys/bacnet_datalink/Kconfig
```kconfig
# Kconfig - Subsystem configuration options
#
# @author Luiz Santana <luiz.santana@dsr-corporation.com>
# @date May 2026
# @copyright SPDX-License-Identifier: Apache-2.0
config BZLL_RECEIVE_PACKET_COUNT
    int "BZLL receive packet count"
    range 1 256
    default 2
    help
      Number of packets in the BZLL receive queue. This value must be a
      power of 2.

config BZLL_NODE_TIME_TO_LIVE_S
    int "BZLL node time-to-live in the VMAC table"
    default 600
    help
       Time in seconds to keep a node in the VMAC table before it must be updated.

config BZLL_SCAN_NODES_INTERVAL_S
    int "BZLL interval for scanning the Zigbee network for BACnet nodes and updating the VMAC table"
    default 3600
    help
       Time interval in seconds between scans of the Zigbee network for BACnet nodes to update the VMAC table.

config DLMSTP_MAX_INFO_FRAMES
    int "Maximum number of MS/TP information frames queued"
    range 1 128
    default 1
    depends on BACDL_MSTP
    help
      Maximum number of received MS/TP information frames buffered for
      the application.
```

## zephyr/subsys/bacnet_datalink/rs485/Kconfig
```kconfig
# Kconfig - Subsystem RS485 Driver configuration options
#
# @author Steve Karg <skarg@users.sourceforge.net>
# @date January 2025
# @copyright SPDX-License-Identifier: Apache-2.0

config BACNET_DRIVER_RS485
	bool "BACnet MS/TP RS485 Driver support"
	select RING_BUFFER
	imply SERIAL_SUPPORT_INTERRUPT
	imply UART_INTERRUPT_DRIVEN
	imply UART_USE_RUNTIME_CONFIGURE
	default y
	help
	  Enables BACnet implementation of RS485 driver for MS/TP
```

## zephyr/subsys/bacnet_shell/Kconfig
```kconfig
# Kconfig - Subsystem Shell configuration options
#
# @author Steve Karg <skarg@users.sourceforge.net>
# @date May 2024
# @copyright SPDX-License-Identifier: Apache-2.0

menuconfig BACNETSTACK_BACNET_SHELL
    bool "BACNETSTACK_BACNET_SHELL"
    default y if BACNETSTACK && SHELL
    help
      This option enables BACnet Shell services

if BACNETSTACK_BACNET_SHELL

    module = BACNETSTACK_BACNET_SHELL
    module-str = bacnet_shell

    config BACNETSTACK_BACNET_BASIC_SHELL
        bool "BACnet Basic subsystem shell"
        default n
        depends on BACNETSTACK_BACNET_SHELL
        help
          Enable BACnet Basic subsystem shell support

    config BACNETSTACK_BACNET_FILE_SHELL
        bool "BACnet File object shell"
        depends on BACNETSTACK_BACNET_SHELL && BACNET_BASIC_OBJECT_FILE
        default n
        select JSON_LIBRARY
        select CRC
        help
          Enable shell commands for transferring and inspecting BACnet File
          object contents.

    config BACNETSTACK_BACNET_FILE_SHELL_CHUNK_SIZE
        int "BACnet File shell transfer chunk size"
        depends on BACNETSTACK_BACNET_FILE_SHELL
        range 1 64
        default 64
        help
          Maximum number of file bytes transferred by one read, write, or
          JSON import command. The build checks that the command fits in the
          configured shell command buffer.

endif # BACNETSTACK_BACNET_SHELL
```

## zephyr/tests/bacnet/bacdcode/testcase.yaml
```yaml
tests:
  bacnet.bacdcode.unit:
    skip: true # TODO: Remove once unit test builds/runs under Zephyr CI
    tags: bacnet
    type: unit
  bacnet.bacdcode:
    tags: bacnet
```

## zephyr/tests/subsys/bacnet_lock/testcase.yaml
```yaml
tests:
  bacnet.subsys.bacnet_lock:
    tags: bacnet shell
    integration_platforms:
      - native_sim
    platform_allow:
      - native_sim
```

## zephyr/tests/subsys/bacnet_shell_file/testcase.yaml
```yaml
tests:
  bacnet.subsys.bacnet_shell_file:
    tags: bacnet shell
    integration_platforms:
      - native_sim
    platform_allow:
      - native_sim
```
